## boards/arm/gugu_main_board/Kconfig.board
```kconfig
config BOARD_GUGU_MAIN_BOARD
    bool "Gugu Main Board"
    depends on SOC_STM32F746XX
```

## west.yml
```yaml
# Copyright (c) 2021 Nordic Semiconductor ASA
# SPDX-License-Identifier: Apache-2.0

manifest:
  self:
    path: zephyr-stutter-detection

  remotes:
    - name: zephyrproject-rtos
      url-base: https://github.com/zephyrproject-rtos

  projects:
    - name: zephyr
      remote: zephyrproject-rtos
      revision: main
      import:
        # By using name-allowlist we can clone only the modules that are
        # strictly needed by the application.
        name-allowlist:
          - cmsis
          - hal_stm32
```
